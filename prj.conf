## prj.conf
```kconfig
# If this is set, dumps from trace core right to BLE ASAP
# this takes a lot of space 

# Memory reduction
CONFIG_ISR_STACK_SIZE=512
#CONFIG_SYSTEM_WORKQUEUE_STACK_SIZE=0

# State machine
CONFIG_HEAP_MEM_POOL_SIZE=1024

# FOTA
CONFIG_BOOTLOADER_MCUBOOT=y
CONFIG_IMG_MANAGER=y

#bluetooth le
CONFIG_BT=y
CONFIG_BT_CENTRAL=y
CONFIG_BT_PERIPHERAL=y
CONFIG_BT_BROADCASTER=y
CONFIG_BT_OBSERVER=y
CONFIG_BT_GATT_CLIENT=y
CONFIG_BT_SCAN=y

# peripherals
CONFIG_SPI=y
CONFIG_GPIO=y

# crpyto
#CONFIG_MBEDTLS=y
#CONFIG_APP_LINK_WITH_MBEDTLS=y

CONFIG_FLASH=y
CONFIG_FLASH_PAGE_LAYOUT=y
CONFIG_MPU_ALLOW_FLASH_WRITE=y
CONFIG_SOC_FLASH_NRF_EMULATE_ONE_BYTE_WRITE_ACCESS=y

# Crypto
CONFIG_NORDIC_SECURITY_BACKEND=y
CONFIG_NRF_SECURITY_RNG=y
CONFIG_ENTROPY_GENERATOR=y

# these caused crashes - need to invistage
#CONFIG_MBEDTLS_ENABLE_HEAP=y
#CONFIG_MBEDTLS_HEAP_SIZE=8192

#CONFIG_ASSERT=y
#CONFIG_STACK_CANARIES=y 

# Config logger
CONFIG_LOG=y
CONFIG_LOG_DEFAULT_LEVEL=4
#CONFIG_DEBUG_OPTIMIZATIONS=y
CONFIG_LOG_PRINTK=y

# Segger RTT
CONFIG_USE_SEGGER_RTT=y
CONFIG_RTT_CONSOLE=y
CONFIG_UART_CONSOLE=n
CONFIG_LOG_BACKEND_RTT=y
CONFIG_LOG_BACKEND_UART=n
```

## boards/thingy52_nrf52832.overlay
```dts
&spi0 {
  compatible = "nordic,nrf-spi";
  status = "ok";
  sck-pin = <5>;
  mosi-pin = <4>;
  miso-pin = <3>;
};

&i2c0 {
  status = "disabled";
};
```

## src/main.c
```c
/* main.c - Application main entry point */

/*
 * Copyright (c) 2015-2016 Intel Corporation
 *
 * SPDX-License-Identifier: Apache-2.0
 */

#include <zephyr/types.h>
#include <stddef.h>
#include <sys/util.h>
#include <zephyr.h>

#include <bluetooth/bluetooth.h>
#include <bluetooth/hci.h>
#include <bluetooth/conn.h>
#include <bluetooth/uuid.h>
#include <bluetooth/gatt.h>
#include <sys/byteorder.h>
#include <bluetooth/scan.h>

#include <device.h>
#include <devicetree.h>
#include <drivers/gpio.h>
#include <drivers/spi.h>

#include "trace_core.h"
#include "flash_core.h"
#include "time_core.h"
#include "gpio_core.h"
#include "ble_core.h"
#include "signals_core.h"
#include "master_core.h"
#include "emit_core.h"
#include "fota_core.h"
#include "spi_core.h"
#include "global_defines.h"
#include "uwb_core.h"

/**********************************************************
*                                                 STATICS *
**********************************************************/
static const char TAG[] = "MAIN";


void main(void) {
  // get the mac, this way we decide if we are 
  k_sleep(K_MSEC(1000)); // allow time for the prints to come

  init_gpio_core(); 
  spi_init_core();
  init_flash_core();
  init_ble_core();
  init_signals_core();
 
  ESP_LOGI(TAG, "Device specifc data = %d", get_config_data());

  k_sleep(K_MSEC(1000));

  // connect to a central device bia BLE
  connect_core_device();

  // From SNTP, get the network time
  k_sleep(K_MSEC(2000)); // niave, should check if we actually connected to BLE - but
                         // for this tutorial we will assume after 2 minutes we are connected

  // get the the from NTP characteristic on the core device
  get_nw_time();

  // Only one device will run the BLE code
  if (get_config_data() == DEVICE_BLE ){
    while(true){
      k_sleep(K_MSEC(1000));
      int distance = uwb_scan_adv();

      if ( distance <= 0 ){
        continue;
      }

      uwb_packet_t uwb;
      uwb.distance_uwb = distance;
      uwb.time         = get_current_time();

      ESP_LOGI(TAG, "Distance = %d, Time = %d", distance, uwb.time);
      ble_dump_chunk(&uwb, sizeof(uwb_packet_t));
    }
  } else {
     // This device will not use BLE to send 
     // Data to the cloud, the other device will do
     // this
     while(true){
      k_sleep(K_MSEC(1000));
      uwb_scan_adv();
     }
  }
}
```

## src/ble_core.c
```c
#include <zephyr.h>
#include <drivers/flash.h>
#include <storage/flash_map.h>
#include <device.h>
#include <stdio.h>
#include <stdint.h>

#include <bluetooth/bluetooth.h>
#include <bluetooth/hci.h>
#include <bluetooth/conn.h>
#include <bluetooth/uuid.h>
#include <bluetooth/gatt.h>
#include <sys/byteorder.h>
#include <bluetooth/scan.h>

#include "global_defines.h"
#include "ble_core.h"
#include "trace_core.h"
#include "signals_core.h"
#include "time_core.h"

/**********************************************************
*                                                 STATICS *
**********************************************************/
static const char TAG[] = "BLE_CORE";
static handle_key_t uuid_key;
static struct bt_uuid_16  uuid;
static struct bt_gatt_discover_params discover_params;
static char usr_data[MAX_USER_DATA_LEN];
static struct bt_conn *esp_conn;
static int write_status;
K_MUTEX_DEFINE(sync_sem);

//TODO: properly handle this
static char VAL[] = {0,1,2,3,4,5,6,7,8};
static const struct bt_data advertising_data[] = {
	BT_DATA_BYTES(BT_DATA_FLAGS, (BT_LE_AD_GENERAL | BT_LE_AD_NO_BREDR)),
	BT_DATA(BT_DATA_NAME_COMPLETE, DEVICE_NAME, DEVICE_NAME_LEN),
	BT_DATA(BT_DATA_MANUFACTURER_DATA, VAL, 8),
};

/**********************************************************
*                                          IMPLEMENTATION *
**********************************************************/

// if return true,continue parsing
static bool data_cb(struct bt_data *data, void *user_data) {
  adv_packet_t *packet = user_data;

  switch (data->type) {
    case BT_DATA_MANUFACTURER_DATA:
      memcpy(packet->manufactuers_data, data->data, MIN(data->data_len, BLE_MANUFACTURERS_DATA_LEN - 1));
      return true;
    case BT_DATA_NAME_COMPLETE:
      memcpy(packet->name_complete, data->data, MIN(data->data_len, BLE_MANUFACTURERS_NAME_LEN - 1));
      return true;
    default:
      return true;
    }
}

// this tries to sepcifically connect to the ESP32
static void scan_cb_connect(const bt_addr_le_t *addr, int8_t rssi, uint8_t type, struct net_buf_simple *buf) {
  adv_packet_t packet;
  memset(usr_data, 0 , MAX_USER_DATA_LEN);
  memset(&packet, 0, sizeof(packet));

  bt_data_parse(buf, data_cb, &packet);
  
  /* We're only interested in connectable events */
	if (type != BT_GAP_ADV_TYPE_ADV_IND &&
	    type != BT_GAP_ADV_TYPE_ADV_DIRECT_IND) {
		return;
	}


  // Only try to connect to the ESP32 core device 
  if (0 == strncmp(packet.name_complete, CORE_DEVICE_NAME, CORE_DEVICE_LEN)){
    ESP_LOGI(TAG, "Name of device: %s", packet.name_complete);
    ESP_LOGI(TAG, "Found a core device!");
  } else {
    return;
  }

	if (bt_le_scan_stop()) {
		return;
	}

	int err;
  struct bt_conn *conn;
	err = bt_conn_le_create(addr, BT_CONN_LE_CREATE_CONN,
				BT_LE_CONN_PARAM_DEFAULT, &conn);

  //todo - handle err (rekick connection?)
}


// this only records advertising packets
static void scan_cb_record(const bt_addr_le_t *addr, int8_t rssi, uint8_t type, struct net_buf_simple *buf) {
  adv_packet_t packet;
  memset(usr_data, 0 , MAX_USER_DATA_LEN);
  memset(&packet, 0, sizeof(packet));

  packet.RSSI = rssi;
  bt_data_parse(buf, data_cb, &packet);

  // Push the advertsting packet to trace core
  submit_adv_packet(&packet);
}

static int start_adv(){
	int err = bt_le_adv_start(BT_LE_ADV_NCONN, advertising_data, ARRAY_SIZE(advertising_data),
			      NULL, 0);
	if (err) {
		ESP_LOGE(TAG, "Advertising failed to start (err %d)\n", err);
	}
  return err;
}

static void stop_adv(){
  int err = bt_le_adv_stop();
	if (err) {
		ESP_LOGE(TAG, "Advertising failed to stop (err %d)\n", err);
	}
}

static void start_scan(void){
	int err;
	ESP_LOGI(TAG, "Starting scanning (no connection)!");

  // don't ask for scan response, don't try to connect
	err = bt_le_scan_start(BT_LE_SCAN_PASSIVE, scan_cb_record);
	if (err) {
		ESP_LOGE(TAG,"Scanning failed to start (err %d)\n", err);
		return;
	}

	ESP_LOGI(TAG, "Scanning successfully started\n");
}

static int generate_fake_incidence(){
  ESP_LOGI(TAG, "Generating fake scanning data!");
  for(int i = 0; i < 300; i++){
    adv_packet_t packet;
    memset(usr_data, 0 , MAX_USER_DATA_LEN);
    memset(&packet, 0, sizeof(packet));
    memcpy(packet.name_complete, DEVICE_NAME, DEVICE_NAME_LEN);

    // fake the advertising data
    k_sleep(K_MSEC(3));
    packet.manufactuers_data[3] = k_uptime_get();
    k_sleep(K_MSEC(3));
    packet.manufactuers_data[1] = k_uptime_get();

    // Push the advertsting packet to trace core
    submit_adv_packet(&packet);
  }
}

static int start_scan_connect(void){
	int err;
	ESP_LOGI(TAG, "Starting scanning + connecting \n");

  // don't ask for scan response
	struct bt_le_scan_param scan_param = {
		.type       = BT_HCI_LE_SCAN_PASSIVE,
		.options    = BT_LE_SCAN_OPT_NONE,
		.interval   = 0x0010,
		.window     = 0x0010,
	};

	err = bt_le_scan_start(&scan_param, scan_cb_connect);
	if (err) {
		ESP_LOGE(TAG, "Scanning failed to start (err %d)\n", err);
	}

	ESP_LOGI(TAG, "Scanning successfully started\n");
	return err;
}

static void stop_scan(void){
	int err;
	ESP_LOGI(TAG, "stopping scanning! \n");

	err = bt_le_scan_stop();
  if (!err){
    return;
  }

	ESP_LOGI(TAG, "failled to stop scanning: error %d \n", err);
}

static void disconnect_remote(){
  if(esp_conn){
    bt_conn_disconnect(esp_conn, BT_HCI_ERR_REMOTE_USER_TERM_CONN);
  }
}

// scans for advertising packets.
// does not attempt to connect
int start_scan_record(){
#ifndef BLE_TEST_MODE
  set_blue_led(1);
  start_scan();
  start_adv();
	k_sleep(K_SECONDS(SCAN_DURATION_SECONDS));
  stop_scan();
  stop_adv();
  set_blue_led(0);
#else
  generate_fake_incidence();
#endif

  return 0;
}

static int start_scan_and_connect(){
  return start_scan_connect();
}

static void init_kernel_objects(){

}

static uint8_t discover_func(struct bt_conn *conn,
			     const struct bt_gatt_attr *attr,
			     struct bt_gatt_discover_params *params) {
	int err;

	if (!attr) {
		return BT_GATT_ITER_STOP;
	}

  // print out the UUID details
  memset(usr_data, 0, MAX_USER_DATA_LEN);
  bt_uuid_to_str(attr->uuid, usr_data, MAX_USER_DATA_LEN);
	ESP_LOGI(TAG, "[ATTRIBUTE] handle %u", attr->handle);
	ESP_LOGI(TAG,"[ATTRIBUTE] uuid %s", usr_data);

 
 // see: https://github.com/zephyrproject-rtos/zephyr/issues/35363
 // The reason why are you getting the "wrong" handle is
 // because a characteristic is split into two attributes,
 // the characteristic declaration, and the characteristic value.
 // When doing the Discover Characteristics by UUID procedure
 // you will receive the characteristic declaration attribute, 
 // the value of this attribute contains
 // the handle of the characteristic value attribute.

	if (bt_uuid_cmp(discover_params.uuid, BT_UUID_SERVICE_CW)==0) {
    ESP_LOGI(TAG, "Discovered CW-100 service!");  
    memcpy(&uuid, BT_UUID_TIME_VALUE, sizeof(uuid));
    discover_params.uuid = &uuid.uuid;
  	discover_params.start_handle = attr->handle + 1;
	  discover_params.type = BT_GATT_DISCOVER_CHARACTERISTIC;

	  err = bt_gatt_discover(conn, &discover_params);
	  if (err) {
		  ESP_LOGE(TAG, "Discover failed (err %d)\n", err);
	  }
  } else if (bt_uuid_cmp(discover_params.uuid, BT_UUID_TIME_VALUE)==0) { 
	  uuid_key.time = attr->handle + 1;
    ESP_LOGI(TAG, "Discovered TIME characteristic");  
		
    memcpy(&uuid, BT_UUID_DUMP_VALUE, sizeof(uuid));
    discover_params.uuid = &uuid.uuid;
    discover_params.start_handle = attr->handle + 1;
    discover_params.type = BT_GATT_DISCOVER_CHARACTERISTIC;
    err = bt_gatt_discover(conn, &discover_params);
	  if (err) {
		  ESP_LOGI(TAG, "Discover failed (err %d)\n", err);
	  }
  } else if (bt_uuid_cmp(discover_params.uuid, BT_UUID_DUMP_VALUE)==0) { 
    ESP_LOGI(TAG, "Discovered DUMP characteristic");  
	  uuid_key.dump = attr->handle + 1;

		memcpy(&uuid, BT_UUID_FW_VER_VALUE, sizeof(uuid));
    discover_params.uuid = &uuid.uuid;
    discover_params.start_handle = attr->handle + 1;
    discover_params.type = BT_GATT_DISCOVER_CHARACTERISTIC;
    err = bt_gatt_discover(conn, &discover_params);
	  if (err) {
		  ESP_LOGE(TAG, "Discover failed (err %d)\n", err);
	  }
    // At this point, the connection should be ready for use
    signal_event(WAIT_FOR_CONNECTION);
    return BT_GATT_ITER_STOP;
  }

  return BT_GATT_ITER_STOP;
}

static void connected(struct bt_conn *conn, uint8_t err) {
  memset(usr_data, 0, sizeof(usr_data)); 
 
  if (err) {
    ESP_LOGE(TAG, "Connection failed (err %u) \n", err);
  } else {
    ESP_LOGI(TAG, "Connected \n");
    esp_conn = conn;
  }
	
  bt_addr_le_to_str(bt_conn_get_dst(conn), usr_data, sizeof(usr_data));
  ESP_LOGI(TAG, "Connected: %s\n", usr_data);
 
  memset(&discover_params, 0, sizeof(discover_params));
  if (conn) {
    memcpy(&uuid, BT_UUID_SERVICE_CW, sizeof(uuid));
    discover_params.uuid = &uuid.uuid;
    discover_params.func = discover_func; 
    discover_params.start_handle = BT_ATT_FIRST_ATTTRIBUTE_HANDLE; 
    discover_params.end_handle = BT_ATT_LAST_ATTTRIBUTE_HANDLE; 
    discover_params.type = BT_GATT_DISCOVER_PRIMARY;

    err = bt_gatt_discover(conn, &discover_params); 
    if (err) { 
      ESP_LOGE(TAG, "Discover failed(err %d)\n", err); 
      return; 
    }
  }
}

static void disconnected(struct bt_conn *conn, uint8_t reason)
{
	char addr[BT_ADDR_LE_STR_LEN];

	if (conn != esp_conn) {
		return;
	}

	bt_addr_le_to_str(bt_conn_get_dst(conn), addr, sizeof(addr));


	bt_conn_unref(esp_conn);
	esp_conn = NULL;
  
	ESP_LOGI(TAG, "Disconnected: %s (reason 0x%02x) - signalling disconection", addr, reason);
#if 0
  signal_event(WAIT_FOR_DISCONNECT);
#endif 
}

static struct bt_conn_cb conn_callbacks = { 
  .connected = connected,
  .disconnected = disconnected,
};

void init_ble_core(){
  int err;

	/* Initialize the Bluetooth Subsystem */
	err = bt_enable(NULL);
	if (err) {
		ESP_LOGE(TAG, "Bluetooth init failed (err %d)\n", err);
	  ASSERT(0);
  }

  // register connect/disconnect callback
  bt_conn_cb_register(&conn_callbacks);

  init_kernel_objects();
}

static void callback_write_dump(struct bt_conn *conn, uint8_t err,
				     struct bt_gatt_write_params *params){

	ESP_LOGI(TAG, "[write] error  %d", err);
	ESP_LOGI(TAG, "[write] handle %d", params->handle);
  
  // set global (does this need a memory barrier?)
  write_status = 1;

  if(err){
    ESP_LOGI(TAG, "Error on write!");
    signal_event(WAIT_FOR_WRITE);
  }

  //TODO: do we need a mutex for the key?
  if (params->handle != uuid_key.dump){
    ESP_LOGI(TAG, "Unknown write?!");
  } else {
    write_status = 0;
    signal_event(WAIT_FOR_WRITE);
  }
}

static uint8_t callback_read_network(struct bt_conn *conn, uint8_t err,
				    struct bt_gatt_read_params *params,
				    const void *data, uint16_t length){
 
	ESP_LOGI(TAG, "[READ] error  %d", err);
	ESP_LOGI(TAG, "[READ] lenght %d", length);
 
  if (!err){
    if (params->handle_count == SINGLE_READ){
      if (params->single.handle == uuid_key.time){  
          uint32_t time = *(uint32_t*)(data);
	        ESP_LOGI(TAG, "[READ] time %u\n", time);
          
          // Time core can chose to ignore the time (ie, if it's zero, etc)
          if (set_current_time(time) == 0){
            signal_event(WAIT_FOR_SNTP);
          } else {
            ESP_LOGE(TAG, "Something fishy new STNP time...!");
          }
          // don't keep on reading
          return BT_GATT_ITER_STOP; 
       }
    }
  }
  return BT_GATT_ITER_CONTINUE;
}


// requires connection
int get_nw_time(){
  // Enqueue the read
  struct bt_gatt_read_params read_parms;
  memset(&read_parms, 0, sizeof(read_parms));
  read_parms.func          = callback_read_network;
  read_parms.handle_count  = SINGLE_READ ;
  read_parms.single.handle = uuid_key.time;
  read_parms.single.offset = 0; //offset into read
  bt_gatt_read(esp_conn, &read_parms); 

  // Wait for read to come through  
  if(poll_event(WAIT_FOR_SNTP, CONNECTION_TIMEOUT)){
    // Failed to get SNTP time
    ESP_LOGE(TAG, "Failed to get SNTP time");
    return 0;
  } else {
    ESP_LOGI(TAG, "Set SNTP time");
  }

  return 1;
}

// returns 0 on good, 1 on error
int connect_core_device(){
  if (start_scan_and_connect()){
    ESP_LOGI(TAG, "Failed to start scanning!");
    return 1; 
  }

  // Wait for Connection + GATT discovery  
  if(poll_event(WAIT_FOR_CONNECTION, CONNECTION_TIMEOUT)){
    ESP_LOGI(TAG, "Failed to connect with ESP!");
    signal_event(WAIT_FOR_SNTP);
    return 1;
  }

  if(!esp_conn){
    ESP_LOGI(TAG, "Can't connect to ESP32 - esp_conn null!");
    signal_event(WAIT_FOR_SNTP);
    return 1;
  }

  return 0;
}

void connection_cleanup(){
  // make sure we disconnect and also stop scanning
  disconnect_remote();
  
  // normal for this to bug out if we already stopped scanning
  stop_scan();
 
// for POC, we will assume disconnect always works
// as the logic for handling remote disconnect
// is not trival

#if 0 
  // Wait for disconnect callback
  if(poll_event(WAIT_FOR_DISCONNECT, DISCONNECT_TIMEOUT)){
    // Failed to get SNTP time
    ESP_LOGE(TAG, "Failed to disconnect - no recovery");
    ASSERT(0);
  } else {
    ESP_LOGI(TAG, "Disconnection done!");
  }
#endif 
}

// upload a BLE incident chunk 
// to the core device
int ble_dump_chunk(uint8_t * chunk, size_t len){
  struct bt_gatt_write_params write_parms;
  memset(&write_parms, 0, sizeof(write_parms));
  write_status = 1; // will be set in callback

  // enqueue write
  ESP_LOGI(TAG, "Writting data of len %d to handle %d", len, uuid_key.dump);
  write_parms.func   = callback_write_dump;
  write_parms.offset = 0;
  write_parms.length = len;
  write_parms.data   = chunk;
  write_parms.handle = uuid_key.dump; 
  bt_gatt_write(esp_conn, &write_parms);

  // Wait for write to go through
  if(poll_event(WAIT_FOR_WRITE, WRITE_TIMEOUT)){
    // Failed to dump data
    ESP_LOGE(TAG, "Failed to write!");
  } else {
    ESP_LOGI(TAG, "Write done!");
  }

  // set in callbacks
  return write_status;
}
```

## src/ble_core.h
```c
#pragma once

#include <stdint.h>

/**********************************************************
*                                                 DEFINES *
**********************************************************/
// Advertising
#define MAX_USER_DATA_LEN       (100)
#define DEVICE_NAME             ("CW_100_EDGE")
#define DEVICE_NAME_LEN         (sizeof(DEVICE_NAME) - 1)

//UIDS
#define BT_UUID_SERVICE_CW    BT_UUID_DECLARE_16(0x00FF)  // Service that contains the follwoing..
#define BT_UUID_TIME_VALUE    BT_UUID_DECLARE_16(0xB0F0)  // read internet time on ESP32 (SNTP)
#define BT_UUID_DUMP_VALUE    BT_UUID_DECLARE_16(0xDEAD)  // place to dump incidences to 
#define BT_UUID_FW_VER_VALUE  BT_UUID_DECLARE_16(0xC0FE)  // lastest FW version
#define BT_UUID_FW_REQ_VALUE  BT_UUID_DECLARE_16(0xFACE)  // request a fw chunk
#define BT_UUID_FW_VALUE      BT_UUID_DECLARE_16(0x1234)  // actual FW chunk

//Scan
#define SCAN_DURATION_SECONDS (15)

//Misc
#define MAX_USER_DATA_LEN          (100)
#define BLE_MANUFACTURERS_DATA_LEN (20)
#define BLE_MANUFACTURERS_NAME_LEN (20)

// this is the ESP32 device 
#define CORE_DEVICE_NAME           ("CW_100_CORE")
#define CORE_DEVICE_LEN            (strlen(CORE_DEVICE_NAME))
#define ADV_SIZE_PACKET            (64) 

//Timeouts
#define CONNECTION_TIMEOUT (30) // how long to wait for a connection
#define DISCONNECT_TIMEOUT (30) // how long to wait for a disconnection
#define WRITE_TIMEOUT      (60) // how long to wait for a disconnection
#define SNTP_TIMEOUT       (30) // how long to wait for GATT read of SNTP

// GATT reads
#define SINGLE_READ (1)

// If defined, makes fake incidence readings
// #define BLE_TEST_MODE 
/**********************************************************
*                                                   TYPES *
**********************************************************/
// to do, move this someplace else, it's used in UWB as well
typedef struct {
    uint8_t  name_complete[BLE_MANUFACTURERS_NAME_LEN]; 
    uint8_t  manufactuers_data[BLE_MANUFACTURERS_DATA_LEN];
    int8_t   RSSI;
    uint16_t uwb_distance_cm;
    uint8_t spare[21];
}__attribute__((packed)) adv_packet_t;
_Static_assert(sizeof(adv_packet_t) == ADV_SIZE_PACKET, "adv packet is not 64 bytes long! (needs to be 2^n allgined)");


// a key to the handle to UUIDs of interest
typedef struct {
  bool     valid;
  uint16_t time;
  uint16_t dump;
  uint16_t fw_ver;
  uint16_t fw_req;
  uint16_t fw_val;
} handle_key_t;

/**********************************************************
*                                                 GLOBALS *
**********************************************************/
void init_ble_core();
int  connect_core_device();
int  get_nw_time();
int  start_scan_record();
void connection_cleanup();
int  ble_dump_chunk(uint8_t * chunk, size_t len);
```

## src/emit_core.c
```c
#include <zephyr.h>
#include <stdio.h>
#include <stdint.h>

#include "global_defines.h"
#include "time_core.h"
#include "master_core.h"
#include "emit_core.h"
#include "signals_core.h"
#include "state_core.h"
#include "flash_core.h"
#include "gpio_core.h"
#include "ble_core.h"
#include "uwb_core.h"

/**********************************************************
*                                                 STATICS *
**********************************************************/
static const char TAG[] = "EMIT_CORE";

K_THREAD_STACK_DEFINE(emit_thread_area, STACK_SIZE_MASTER);
static struct k_thread emit_thread_data;  


/**********************************************************
*                                                FORWARDS *
**********************************************************/
static state_t func_check_status();
static state_t func_scan_advertise();

/**********************************************************
*                                          IMPLEMENTATION *
**********************************************************/
static void next_state_func(state_t* curr_state, state_event_t event) {
    if (!curr_state) {
        ESP_LOGE(TAG, "ARG==NULL!");
        ASSERT(0);
    }
}

// All events are FROM emit core TO emit core
static bool event_filter_func(state_event_t event) {
    return false;
}

static state_array_s func_translation_table[emit_state_len] = {
  { func_check_status   , 30              , NULL },
  { func_scan_advertise , STATE_DONT_LOOP , NULL },
};

static char* event_print_func(state_event_t event) {
    return NULL;
}


static state_init_s* get_emit_state_handle() {

    // variaous statics required for state operation
    static char __aligned(4) emit_msgq_buffer[GENERIC_MESSGE_Q_DEPTH * sizeof(state_t)];
    static struct k_msgq emit_msgq;
    k_msgq_init(&emit_msgq, emit_msgq_buffer, sizeof(state_t), GENERIC_MESSGE_Q_DEPTH);

    static state_init_s state = {
        .next_state                       = next_state_func,
        .translation_table                = func_translation_table,
        .starting_state                   = emit_state_check_status,
        .event_print                      = event_print_func,
        .state_name_string                = "emit_state",
        .filter_event                     = event_filter_func,
        .total_states                     = emit_state_len,
        .state_queue_input_handle         = &emit_msgq,
    };
    return &(state);
}

void init_emit_core(){
  start_new_state_machine(get_emit_state_handle(), &emit_thread_data, emit_thread_area, STACK_SIZE_EMIT);
}

// this relies on the looping feature of the state machine
// to work. (will get called every X seconds)
static state_t func_check_status() {
  ESP_LOGI(TAG, "Entering SNTP State");
  if (get_current_time() == MAX_TIME){
     ESP_LOGI(TAG, "No time, fetching from ble!");
     state_post_event(MASTER_EVENT_SNTP);
     goto pend_sntp_worker;
  }

  if (get_time_age() > STALE_TIME_COUNT){
     ESP_LOGI(TAG, "time stale, fetching from ble!");
     state_post_event(MASTER_EVENT_SNTP);
     goto pend_sntp_worker;
  } 

  return emit_state_scan_advertise;

pend_sntp_worker:
  if(poll_event(WAIT_FOR_WORKER, WAIT_PERIOD_SNTP)){
    ESP_LOGI(TAG, "Timeout waiting for SNTP worker!");
    ASSERT(0); // no recovery here - state machine out of whack
  } else {
    ESP_LOGE(TAG, "SNTP worker done!");
  }
  return NULL_STATE; 

pend_dump_worker:
  if(poll_event(WAIT_FOR_WORKER, WAIT_PERIOD_DUMP)){
    ESP_LOGI(TAG, "Timeout waiting for dump worker!");
    ASSERT(0); // no recovery here - state machine out of whack
  } else {
    ESP_LOGE(TAG, "Dump worker done!");
  }
  return NULL_STATE; 
}


static state_t func_scan_advertise(){
  int time_past  = time_past_previous_advertise_cycle();
  ESP_LOGI(TAG, "%d Seconds passed from previous advertising cycle, current time %u", time_past, get_current_time());

  //Scan UWB 
  uwb_scan_adv();

  // If we have more than 2 valid pages, upload the first valid page 
  get_oldest_page();
  state_post_event(MASTER_EVENT_DUMP); 
   
  if(poll_event(WAIT_FOR_WORKER, WAIT_PERIOD_DUMP)){
    ESP_LOGI(TAG, "Timeout waiting for dump worker!");
    ASSERT(0); // no recovery here - state machine out of whack
  } else {
    ESP_LOGI(TAG, "Dump worker done!");
  }

  k_sleep(K_SECONDS(SLEEP_PERIOD)); 
  return emit_state_check_status;
} 
```

## src/emit_core.h
```c
#pragma once

#include <zephyr.h>
#include <stdint.h>

/**********************************************************
*                                                 DEFINES *
**********************************************************/
#define STACK_SIZE_EMIT                          (1024)
#define WAIT_PERIOD_SNTP                         (60)
#define WAIT_PERIOD_DUMP                         (60*10) //Might take a while to unload
#define SLEEP_PERIOD                             (17)    //random prime number
#define MAX_AGE_PARTIAL_PAGE_BEFORE_UPLOAD_HOURS (4)

/**********************************************************
*                                                   TYPES *
**********************************************************/
typedef enum {
    emit_state_check_status,
    emit_state_scan_advertise,
    emit_state_fota,     //this state also dumps the flash

    emit_state_len
} emit_state_e;

// Emit core does not react to any events,
// it's driven by the state returns 
typedef enum {
    EMIT_EVENT_NONE = 0,         

    emit_event_len //LEAVE AS LAST!
} emit_event_e;

/**********************************************************
*                                                 GLOBALS *
**********************************************************/
void init_emit_core();
```

## src/flash_core.c
```c
#include <zephyr.h>
#include <drivers/flash.h>
#include <storage/flash_map.h>
#include <device.h>
#include <stdio.h>
#include <string.h>

#include "ble_core.h"
#include "global_defines.h"
#include "flash_core.h"
#include "time_core.h"

/**********************************************************
*                                                 STATICS *
**********************************************************/
static const char     TAG[] = "FLASH_CORE";
static uint8_t flash_memblock[FLASH_PAGE_SIZE];

static flash_curr_t   curr;
static flash_oldest_t oldest_info;

static bool flash_has_space;
static void set_flash_full(bool full);

static struct k_mutex flash_mutex;
static const struct device *flash_dev;

static uint8_t uploaded[UPLOAD_CHUNKS_IN_PAGE];

/**********************************************************
*                                                FORWARDS *
**********************************************************/
static int sync_flash_status();
static int set_next_packet_address();

/**********************************************************
*                                          IMPLEMENTATION *
**********************************************************/
static void init_kernel_objects(){
  k_mutex_init(&flash_mutex);
}

void init_flash_core(){
  ESP_LOGI(TAG, "Initing flash core!");
  flash_dev = device_get_binding(DT_CHOSEN_ZEPHYR_FLASH_CONTROLLER_LABEL);

  if (!flash_dev) {
    ESP_LOGE(TAG, "Nordic nRF5 flash driver was not found!");
    ASSERT(0);  
  } 
 
  init_kernel_objects();

  // for the tutorial, don't get the flash contex
#if 0
  // find the first place in flash we can write to
  if(sync_flash_status()){
    set_flash_full(true);
  }else{
    set_flash_full(false);
  }
 
  // set up the structures that keep track of the oldest page (first upload candidate)
  get_oldest_page();
#endif 

#ifdef TEST_MODE_FLASH
  flash_test();
#endif 
}

void print_hex(uint8_t* buffer, size_t buff_len) {
#ifdef CONFIG_LOG
    if (buff_len == 0) {
        return;
    }
    #define BYTES_PER_LINE 16
    char temp_buffer[BYTES_PER_LINE + 3];
    char hex_buffer[3 * BYTES_PER_LINE + 1];
    const char *ptr_line;
    int bytes_cur_line;

    do {
        if (buff_len > BYTES_PER_LINE) {
            bytes_cur_line = BYTES_PER_LINE;
        } else {
            bytes_cur_line = buff_len;
        }
        if (true) {
            //use memcpy to get around alignment issue
            memcpy(temp_buffer, buffer, (bytes_cur_line + 3) / 4 * 4);
            ptr_line = temp_buffer;
        } else {
            ptr_line = buffer;
        }

        for (int i = 0; i < bytes_cur_line; i ++) {
            sprintf(hex_buffer + 3 * i, "%02x ", ptr_line[i]);
        }
        ESP_LOGI(TAG, "%s", hex_buffer);
        buffer += bytes_cur_line;
        buff_len -= bytes_cur_line;
    } while (buff_len);
#endif 
}

void take_flash_sem(){
  k_mutex_lock(&flash_mutex, K_FOREVER);
}

void give_flash_sem(){
  k_mutex_unlock(&flash_mutex);
}

bool get_flash_full(){
  bool ret;
  ret = flash_has_space;
  return ret;
}

static void set_flash_full(bool full){
  flash_has_space = full;
}

static int increment_to_next_valid_page(){
  flash_packet_t test;
  if(curr.current_valid_page == FINAL_VALID_PAGE){
    curr.current_valid_page = FIRST_PAGE_INCIDENCE_DATA; 
  } else{
    curr.current_valid_page = curr.current_valid_page + 1; 
  }

  //ESP_LOGI(TAG, "next candidate == %d \n", curr.current_valid_page);
  int offset = FLASH_PAGE_SIZE*curr.current_valid_page;
  if (flash_read(flash_dev, offset, &test, sizeof(flash_packet_t)) != 0) {
    ESP_LOGE(TAG, "Failed to read flash \n");
    ASSERT(0); 
  }

  if (test.type == PAGE_HEADER_MAGIC){
      return 1;
  }
  
  // next page not full
  return 0;
}


static void parse_header_packet(flash_packet_t *header, int page){
  if(!header){
    ESP_LOGE(TAG, "ARG NULL!");
    ASSERT(0);
  }
  
  if (page < FIRST_PAGE_INCIDENCE_DATA){
    ESP_LOGE(TAG, "Tried reading page %d - this is not allowed!", page);
    ASSERT(0);
  }

  if(page > MAX_VALID_PAGE){
    ESP_LOGE(TAG, "Tried reading page %d - this is not allowed!", page);
    ASSERT(0); 
  }
  
  int offset = FLASH_PAGE_SIZE*page;
  ESP_LOGI(TAG, "Parsing header for page %d, offset %d", page, offset);
  if (flash_read(flash_dev, offset, header, sizeof(flash_packet_t)) != 0) {
      ESP_LOGE(TAG, "Flash read failed!");
      ASSERT(0);
  }
}

static void drop_header_packet(){
  ESP_LOGI(TAG, "dropping header packet");
  flash_packet_t header_packet;
  memset(&header_packet, 0, sizeof(header_packet));

  header_packet.specifics.id   = curr.current_id + 1; // Smallest valid current ID is 1 
  header_packet.type           = PAGE_HEADER_MAGIC; 
  header_packet.utc            = get_current_time(); 

  // TODO: better handle!
  int offset = FLASH_PAGE_SIZE*curr.current_valid_page;
  if (flash_write(flash_dev, offset, &header_packet, sizeof(flash_packet_t)) != 0) {
      ESP_LOGE(TAG, "Flash write failed!");
  }
}

void write_packet(trace_packet_t* trace_packet){
  flash_packet_t flash_packet;
  memset(&flash_packet, 0, sizeof(flash_packet));

  if (get_flash_full()){
    return;
  }

  int offset = FLASH_PAGE_SIZE*curr.current_valid_page + curr.current_valid_packet_in_page*FLASH_SIZE_PACKET;
  if(curr.current_valid_packet_in_page == HEADER_PACKET_OFFSET){
    ESP_LOGI(TAG, "Writting a (header) packet to %d, page %d packet offset %d, id = %d", 
        offset, curr.current_valid_page, curr.current_valid_packet_in_page, curr.current_id);  

    drop_header_packet();
    curr.total_valid_pages++;
    curr.current_valid_packet_in_page++;
    // recalculate offset for next write
    offset = FLASH_PAGE_SIZE*curr.current_valid_page + curr.current_valid_packet_in_page*FLASH_SIZE_PACKET; 
  }
 
  flash_packet.type   = PAGE_NORMAL_ENTRY_MAGIC; 
  flash_packet.RSSI   = trace_packet->RSSI;
  flash_packet.counts = trace_packet->counts; 
  flash_packet.utc    = trace_packet->utc;
  memcpy(flash_packet.manufactuers_data, trace_packet->manufactuers_data, BLE_MANUFACTURERS_DATA_LEN);
  
  // TODO: better handle!
  ESP_LOGI(TAG, "Writting a packet to %d, page %d packet offset %d", offset, curr.current_valid_page, curr.current_valid_packet_in_page);  
  if (flash_write(flash_dev, offset, &flash_packet, sizeof(flash_packet_t)) != 0) {
      printf("Flash write failed!\n");
  }

  // get the next empty address for the next write
  if(set_next_packet_address()){
    printf("Flash is now full! \n");
    set_flash_full(true);
  }
}

// There are 128 pages in the device,
// out of this, TOTAL_PAGES_FOR_INCIDENCE_DATA, is used for the image,
// there are two banks of possible valid images, bank0 and bank1,
// when FOTA is not happening, the second bank is used to store
// covid tracing information.
//
// The first ever covid tracing information is written to the first page 
// in the second bank, (page == FIRST_PAGE_IMAGE_1), then the next page, 
// and so forth. When uploading, the oldest page is uploaded first. To keep track 
// of the age of the page, there will be a page header in each page, this will
// have a "page_id" field which will be incremented by 1 every time a new page is written
// this value will start at one and go up to uint32_max (although flash will wear out before then)   
      
// return 0, we have space
// return 1, we are full
static int sync_flash_status(){
  ESP_LOGI(TAG, "First page of incidence data = %d offset = %d, total pages = %d",
       FIRST_PAGE_INCIDENCE_DATA, OFFSET_TO_FIRST_INCIDENCE_DATA, TOTAL_PAGES_FOR_INCIDENCE_DATA );
  
  ESP_LOGI(TAG, "Finding first emtpy page \n");

  if (flash_dev == NULL){
    printf("FAILED - flash dev not init! \n");
    ASSERT(0);
  }

  uint32_t offset;
  flash_packet_t test;
  curr.current_valid_page = FIRST_PAGE_INCIDENCE_DATA;

  for(int i = 0; i < TOTAL_PAGES_FOR_INCIDENCE_DATA; i++){
    offset = (FIRST_PAGE_INCIDENCE_DATA + i) * FLASH_PAGE_SIZE;
    printf("Checking page offset = %d, number = %d \n", offset, i + FIRST_PAGE_INCIDENCE_DATA);
    k_sleep(K_MSEC(1)); // the prints above cause issues with RTT - not required
    
    if (flash_read(flash_dev, offset, &test, sizeof(test)) != 0) {
      printf("Failed to read flash \n");
      ASSERT(0); 
    }

    if (test.type == PAGE_HEADER_MAGIC){
      printf("Found a header packet page ID == %d \n", test.specifics.id);
      curr.total_valid_pages++;
      if (test.specifics.id > curr.current_id){
        printf("Found a new candidate for largest id = %d\n" , test.specifics.id);
        curr.current_valid_page = i + FIRST_PAGE_INCIDENCE_DATA;
        curr.current_id = test.specifics.id;
      }
    }
  }

  offset = FLASH_PAGE_SIZE*curr.current_valid_page;
  ESP_LOGI(TAG, "current valid page == %d, find first valid offset in page \n", curr.current_valid_page);
  if (flash_read(flash_dev, offset, flash_memblock, FLASH_PAGE_SIZE) != 0) {
      printf("Failed to read flash");
      ASSERT(0);
  }

  flash_packet_t * packet_ptr = (flash_packet_t*)flash_memblock;
  for(int i = 0; i < PACKETS_IN_PAGE; i++){
     if(packet_ptr->type == PAGE_HEADER_MAGIC_EMTPY){
        ESP_LOGI(TAG, "Found empty packet (packet offset in page) %d in page %d \n", i, curr.current_valid_page);
        curr.current_valid_packet_in_page = i;
        return 0;    
     }
     // increment to next packet
     packet_ptr++;
  }
  
  // this is rare, if we get here, there is a full page, but we didn't get another advertising 
  // packet that would have created the next page.
  if (increment_to_next_valid_page()){
      ESP_LOGE(TAG, "device is full! \n");
      set_flash_full(true);
      return 1;
  }

  curr.current_valid_packet_in_page = 0;
  curr.current_id++;
  ESP_LOGI(TAG, "next empty page, offset = %d, %d \n", curr.current_valid_page, curr.current_valid_packet_in_page);
  return 0;
}

// if true, there is another availible packet in flash
// false - we are full
static int set_next_packet_address(){
  // test if we still have room in the current page
  if (curr.current_valid_packet_in_page != FINAL_VALID_PACKET_OFFSET){
    curr.current_valid_packet_in_page = curr.current_valid_packet_in_page + 1;  
    return 0;
  }

  printf("ran out of packets in page, will try to goto next page! \n");
  if (increment_to_next_valid_page()){
      printf("device is full!");
      set_flash_full(true);
      return 1;
  }

  // next page is valid
  curr.current_valid_packet_in_page = 0;
  curr.current_id++; 
  return 0;
}

//TODO: can we optimize this?
uint32_t get_oldest_page(){
  ESP_LOGI(TAG, "Calculating oldest page!");
  oldest_info.oldest_id = MAX_VALID_ID;
  flash_packet_t test;

  for(int i = 0; i < TOTAL_PAGES_FOR_INCIDENCE_DATA; i++){
    int offset =  OFFSET_TO_FIRST_INCIDENCE_DATA + FLASH_PAGE_SIZE*i;
    ESP_LOGI(TAG, "Checking page == %d (for oldest)", offset);
    
    if (flash_read(flash_dev, offset, &test, sizeof(flash_packet_t)) != 0) {
      ESP_LOGI(TAG, "Failed to read flash");
      ASSERT(0); 
    }

    if (test.type == PAGE_HEADER_MAGIC){
      ESP_LOGI(TAG, "Found a header packet page ID == %d", test.specifics.id);
      if ( test.specifics.id < oldest_info.oldest_id ){
        ESP_LOGI(TAG, "Found a new candidate for oldest page = %d" , test.specifics.id);
        oldest_info.oldest_id = test.specifics.id;
        oldest_info.oldest_id_page = i + FIRST_PAGE_INCIDENCE_DATA;
      }
    }
  }

  ESP_LOGI(TAG, "Oldest page == %u, oldest_id_page == %u", oldest_info.oldest_id, oldest_info.oldest_id_page);
  return oldest_info.oldest_id;
}

// erase a PAGE (not offset!)
static void erase_page(uint32_t id){
  if (id < FIRST_PAGE_INCIDENCE_DATA){
    ESP_LOGE(TAG, "Tried deleting page %d - this is not allowed!", id);
    ASSERT(0);
  }

  if(id > MAX_VALID_PAGE){
    ESP_LOGE(TAG, "Tried deleting page %d - this is not allowed!", id);
    ASSERT(0); 
  }

  int offset = id*FLASH_PAGE_SIZE;
  if (flash_erase(flash_dev, offset, FLASH_PAGE_SIZE) != 0) {
    ESP_LOGE(TAG, "Failed to delete page %d ?!", id);
    ASSERT(0);
  } else { 
    ESP_LOGE(TAG, "Deleted page %d", id);
  }
}

// The flash layer has no idea if the BLE chunk
// was sent or not - the shim will be responsible 
// for that logic, the shim will inform the flash
// layer of the status of the BLE chunk transmit
void set_chunk_sent(uint32_t chunk){
  if (chunk > UPLOAD_CHUNKS_IN_PAGE){
    ESP_LOGE(TAG, "setting chunk (%d) out of range!", chunk);
  }
  
  ESP_LOGE(TAG, "Uploaded chunk(%d)!", chunk);
  uploaded[chunk] = true;

  // chunk is 0 indexed
  // on the final chunk sent, reset the logic
  if(chunk == UPLOAD_CHUNKS_IN_PAGE - 1){
    ESP_LOGI(TAG, "Finished uploading page %d", oldest_info.oldest_id);
    memset(uploaded, 0, sizeof(uploaded));
    erase_page(oldest_info.oldest_id_page);
    curr.total_valid_pages--;
    get_oldest_page();
  }
}

// returns:
//  UPLOADING_DONE         >if nothing left to upload
//  CHUNK_PROBLEM          >if there are problems
//  PAGE_FINISHED_UPLOAD   >if a page was fully uploaded (and internally erased)
//  CHUNK_VALID            >if there is something to push
//          -> data         = (data to upload)
//          -> ready_chunk  = chunk pending to be uploaded
int upload_incident_chunk(uint8_t ** data, uint32_t * ready_chunk){
  if (!ready_chunk){
    ESP_LOGE(TAG, "Error! null arg!");
    ASSERT(0);
  }

  if (oldest_info.oldest_id == MAX_VALID_ID){
    ESP_LOGI(TAG, "Nothing to upload!");
    return UPLOADING_DONE;
  }
  
  int chunk;
  for(chunk = 0; chunk < UPLOAD_CHUNKS_IN_PAGE; chunk++){
    if (uploaded[chunk]){
      continue;
    } 
    ESP_LOGI(TAG, "Chunk %d to be uploaded!", chunk);
    break;
  }
  
  // done uploading
  if(chunk == UPLOAD_CHUNKS_IN_PAGE){
    ESP_LOGI(TAG, "Finished uploading!"); 
    goto cleanup;
  }
  
  memset(flash_memblock, 0, UPLOAD_SIZE_CHUNK);
  int offset = oldest_info.oldest_id_page*FLASH_PAGE_SIZE + chunk*UPLOAD_SIZE_CHUNK; 
  ESP_LOGI(TAG, "uploading offset %d to cloud!", offset);
  if (flash_read(flash_dev, offset, flash_memblock, UPLOAD_SIZE_CHUNK) != 0) {
    ESP_LOGE(TAG, "Flash read of offset %u failed!", offset);
    return CHUNK_PROBLEM; 
  }
  #ifdef CONFIG_LOG
  print_hex(flash_memblock, UPLOAD_SIZE_CHUNK);
  #endif  

  // verify there is data in the page
  // it's possible we send up a partially valid packet,
  // we will let the backend deal w/ that
  flash_packet_t *test = (flash_packet_t*)flash_memblock;
  if (test->type == PAGE_HEADER_MAGIC_EMTPY){
    ESP_LOGI(TAG, "Chunk is empty, not uploading %d", chunk);
    goto cleanup;
  }   
  
  *data = flash_memblock;
  ESP_LOGE(TAG, "Ready to upload chunk %d", chunk);
  *ready_chunk = chunk;
  return CHUNK_VALID;

cleanup:
  memset(uploaded, 0, sizeof(uploaded));
  erase_page(oldest_info.oldest_id_page);
  curr.total_valid_pages--;
  get_oldest_page();
  return PAGE_FINISHED_UPLOAD;
}


// get the oldest page, if there 
// is no oldest page, that means
// the flash is empty
bool flash_is_empty(){
  get_oldest_page();
  if (oldest_info.oldest_id == MAX_VALID_ID){
    return true;
  }
  return false;
}

uint32_t get_age_oldest_page(){
  get_oldest_page();
  if (oldest_info.oldest_id == MAX_VALID_ID){
    return MAX_TIME;
  }
  flash_packet_t header;
  memset(&header, 0, sizeof(header));
  parse_header_packet(&header, oldest_info.oldest_id_page);
  if (header.type == PAGE_HEADER_MAGIC_EMTPY){
    ESP_LOGE(TAG, "Something wrong, page header was not written for page %d?", oldest_info.oldest_id_page);
    ASSERT(0);
  }  

  ESP_LOGI(TAG, "Oldest page is %u old", header.utc);
  return header.utc;
}

uint16_t get_total_valid_pages(){
  return curr.total_valid_pages;
}

void erase_incidence_data(){
  for(int i = 0; i < TOTAL_PAGES_FOR_INCIDENCE_DATA; i++){
    int offset =  OFFSET_TO_FIRST_INCIDENCE_DATA + FLASH_PAGE_SIZE*i;
    ESP_LOGI(TAG, "Erasing page offset %d", offset);
    if (flash_erase(flash_dev, offset, FLASH_PAGE_SIZE) != 0) {
      ESP_LOGE(TAG, "Flash erase failed!\n");
      ASSERT(0);
    }
  }
}

void set_config_data(int id){
    int offset =  FLASH_PAGE_SIZE*MAX_VALID_PAGE;
    if (flash_erase(flash_dev, offset, FLASH_PAGE_SIZE) != 0) {
      ESP_LOGE(TAG, "Flash erase failed!\n");
      ASSERT(0);
    }
    
    memset(flash_memblock, 0, 128);
    memcpy(flash_memblock, &id, 4);
    if (flash_write(flash_dev, offset, flash_memblock, 128) != 0) {
      ESP_LOGE(TAG, "Flash write failed!");
      return;
    }
}

int get_config_data(){
    memset(flash_memblock, 0, 128);
    int offset =  FLASH_PAGE_SIZE*MAX_VALID_PAGE;
    if (flash_read(flash_dev, offset,flash_memblock, 128) != 0) {
      ESP_LOGE(TAG, "Flash read failed!");
      return;
    }
    
    int ret;
    memcpy(&ret, flash_memblock, 4);
    return ret;
}


#ifdef TEST_MODE_FLASH 
#define FIRST_NON_IMAGE_PAGE FLASH_AREA_OFFSET(image_1)
static char test_buff[FLASH_PAGE_SIZE];

void erase_image_1(){
  for(int i = 0; i < TOTAL_PAGES_FOR_INCIDENCE_DATA; i++){
    int offset =  OFFSET_TO_FIRST_INCIDENCE_DATA + FLASH_PAGE_SIZE*i;
    if (flash_erase(flash_dev, offset, FLASH_PAGE_SIZE) != 0) {
      printf("Flash erase failed!\n");
      ASSERT(0);
    }
  }
}

void erase_image_small(){
  for(int i = 0; i < TOTAL_PAGES_FOR_INCIDENCE_DATA; i++){
    int offset =  OFFSET_TO_FIRST_INCIDENCE_DATA + FLASH_PAGE_SIZE*i;
    if (flash_erase(flash_dev, offset, FLASH_PAGE_SIZE) != 0) {
      ESP_LOGE(TAG, "Flash erase failed!\n");
      ASSERT(0);
    }
  }
}

void flash_test(){

set_current_time(1635451240);

//#define FOOBAR
#ifdef FOOBAR
  for(int i = 0; i < 50; i++){
    uint8_t * ptr;
    uint32_t chunk;
    if( 0 == upload_incident_chunk(ptr, &chunk) ){
      //logic (send BLE)

      set_chunk_sent(chunk);
    }
  }
  k_sleep(K_SECONDS(5));
#else
  k_sleep(K_SECONDS(5));
  erase_image_small();
  trace_packet_t foobar;
  
  for(int i = 0; i < 400 ; i++){
    write_packet(&foobar);
  }
  get_age_oldest_page();
  printf("total pages = %d", curr.total_valid_pages);
  k_sleep(K_SECONDS(100));
#endif 

/*

  printf("\nTest 1: Flash erase page at 0x%x\n", FIRST_NON_IMAGE_PAGE);
  if (flash_erase(flash_dev, FIRST_NON_IMAGE_PAGE, FLASH_PAGE_SIZE) != 0) {
    printf("Flash erase failed!\n");
  } else {
    printf("Flash erase succeeded!\n");
  }

  printf("\nTest 2: Flash write (word array 1)\n");
  if (flash_write(flash_dev, FIRST_NON_IMAGE_PAGE, test_buff, FLASH_PAGE_SIZE) != 0) {
      printf("Flash write failed!\n");
      return;
  }

  memset(test_buff, 0 ,FLASH_PAGE_SIZE);
  printf("Attempted to read 0x%x\n", 0);
  if (flash_read(flash_dev, FIRST_NON_IMAGE_PAGE, &test_buff, FLASH_PAGE_SIZE) != 0) {
      printf("   Flash read failed!\n");
      return;
  }
  memset(test_buff, 0 ,FLASH_PAGE_SIZE);
  printf("Attempted to read 0x%x\n", 0);
  if (flash_read(flash_dev, FIRST_NON_IMAGE_PAGE, &test_buff, FLASH_PAGE_SIZE) != 0) {
      printf("   Flash read failed!\n");
      return;
  }

*/
}
#endif 
```

## src/flash_core.h
```c
#pragma once

#include <stdint.h>
#include "trace_core.h"
#include "ble_core.h"

/**********************************************************
*                                                 DEFINES *
**********************************************************/
#define FLASH_PAGE_SIZE                (4096)
#define SPARE_FLASH_PAGES_AT_END       (3)
#define IMAGE_SIZE_IN_PAGES            (0x3A) 
#define OFFSET_TO_FIRST_INCIDENCE_DATA (FLASH_AREA_OFFSET(image_1))  //this is in kb
#define TOTAL_PAGES_FOR_INCIDENCE_DATA (IMAGE_SIZE_IN_PAGES - SPARE_FLASH_PAGES_AT_END)
#define FLASH_SIZE_PACKET              (32)
#define FIRST_PAGE_INCIDENCE_DATA      (FLASH_AREA_OFFSET(image_1)/FLASH_PAGE_SIZE) //page numbers 
#define PACKETS_IN_PAGE                (FLASH_PAGE_SIZE / FLASH_SIZE_PACKET)
#define HEADER_PACKET_OFFSET           (0)

#define MAX_VALID_PAGE            (127)
#define FINAL_VALID_PAGE          (127-SPARE_FLASH_PAGES_AT_END) //last page is for misc use
#define FINAL_VALID_PACKET_OFFSET (PACKETS_IN_PAGE - 1)

#define PAGE_HEADER_MAGIC       (0xDEAD)
#define PAGE_NORMAL_ENTRY_MAGIC (0xC0FE)
#define PAGE_HEADER_MAGIC_EMTPY (0xFFFF)

#define MAX_VALID_ID (0xFFFFFFFF)

#define FLASH_PACKETS_PER_CHUNK (8)
#define UPLOAD_SIZE_CHUNK       (FLASH_SIZE_PACKET * FLASH_PACKETS_PER_CHUNK) 
#define UPLOAD_CHUNKS_IN_PAGE   (FLASH_PAGE_SIZE / UPLOAD_SIZE_CHUNK ) 

#define CHUNK_VALID          (0)
#define PAGE_FINISHED_UPLOAD (1)
#define CHUNK_PROBLEM        (2)
#define UPLOADING_DONE       (3)

//#define TEST_MODE_FLASH // if set, will do a quick sanity check of flash

#define DEVICE_BLE (0xDEAD)

/**********************************************************
*                                                   TYPES *
**********************************************************/
// keep this in sync with what the ESP thinks of as a flash packet
// This is the format we save to flash
// keep it exactly 32 bytes
typedef struct {
    uint16_t type;
    union {
      uint32_t id;           // Only valid for type == page header
      uint32_t distance_uwb; // Only valid for readings
    } specifics;
    uint8_t  manufactuers_data[BLE_MANUFACTURERS_DATA_LEN];
    int8_t   RSSI;
    uint8_t  counts;
    int32_t  utc;
}__attribute__((packed)) flash_packet_t;
_Static_assert(sizeof(flash_packet_t) == FLASH_SIZE_PACKET, "flash packet is not 32 bytes long!");

typedef struct {
  uint32_t oldest_id;
  uint32_t oldest_id_page;
  uint32_t olest_id_age_utc;
} flash_oldest_t;

typedef struct {
  uint32_t current_id;
  uint16_t current_valid_page;
  uint16_t current_valid_packet_in_page;
  uint16_t total_valid_pages;
} flash_curr_t;

/**********************************************************
*                                                 GLOBALS *
**********************************************************/
void     init_flash_core();
uint32_t get_oldest_page();
bool     get_flash_full();
void     write_packet(trace_packet_t* trace_packet);
int      upload_incident_chunk(uint8_t ** data, uint32_t * ready_chunk);
void     set_chunk_sent(uint32_t chunk);
void     take_flash_sem();
void     give_flash_sem();
bool     flash_is_empty();
uint32_t get_age_oldest_page();
uint16_t get_total_valid_pages();
void     set_config_data(int id);
int      get_config_data();
```

## src/fota_core.c
```c
#include <zephyr.h>
#include <stdio.h>
#include <stdint.h>
#include <storage/flash_map.h>
#include <dfu/flash_img.h>
#include <dfu/mcuboot.h>
#include <storage/flash_map.h>

#include "global_defines.h"

/**********************************************************
*                                                 STATICS *
**********************************************************/
static const char TAG[] = "FOTA_CORE";

/**********************************************************
*                                                FORWARDS *
**********************************************************/


/**********************************************************
*                                          IMPLEMENTATION *
**********************************************************/
static int start_fw_update(){
  if(boot_request_upgrade(true) == 0){
    ESP_LOGI(TAG, "FW update started");
    return 0;
  } else {
    ESP_LOGI(TAG, "Failed to start FW update");
    return 1;
  }
  
  // should not get here, 
  // quench compiler warning
  return 1;
}

int switch_image(){
  struct mcuboot_img_header header;
  boot_read_bank_header(FLASH_AREA_ID(image_1), &header, sizeof(header));
  
  if (0 == start_fw_update()){
    k_sleep(K_SECONDS(5));
    sys_reboot(1);
    return 0;
  }
  ESP_LOGE(TAG, "Failed to swap image!");
  return 1;
}

// this is safe to call all teh time, we will do it 
// each boot because otherwise we won't know if we
// did a fota or not
void finalize_image(){
  boot_write_img_confirmed();
}
```
